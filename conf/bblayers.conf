## conf/bblayers.conf
```bitbake
# POKY_BBLAYERS_CONF_VERSION is increased each time build/conf/bblayers.conf
# changes incompatibly
POKY_BBLAYERS_CONF_VERSION = "2"

LAYER_ROOT = "/media/erik/Dev02/Development/RPi4-yocto/"

BBPATH = "${TOPDIR}"
BBFILES ?= ""

BBLAYERS ?= " \
  ${LAYER_ROOT}poky/meta \
  ${LAYER_ROOT}poky/meta-poky \
  ${LAYER_ROOT}poky/meta-yocto-bsp \
  ${LAYER_ROOT}layers/meta-raspberrypi \
  ${LAYER_ROOT}layers/meta-openembedded/meta-filesystems \
  ${LAYER_ROOT}layers/meta-openembedded/meta-gnome \
  ${LAYER_ROOT}layers/meta-openembedded/meta-initramfs \
  ${LAYER_ROOT}layers/meta-openembedded/meta-networking \
  ${LAYER_ROOT}layers/meta-openembedded/meta-oe \
  ${LAYER_ROOT}layers/meta-openembedded/meta-perl \
  ${LAYER_ROOT}layers/meta-openembedded/meta-python \
  ${LAYER_ROOT}layers/meta-openembedded/meta-webserver \
  ${LAYER_ROOT}layers/meta-openembedded/meta-multimedia \
  "
```
